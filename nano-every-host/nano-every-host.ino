#define SERIAL_TX_BUFFER_SIZE 16
#define SERIAL_RX_BUFFER_SIZE 16

#include <zip8.h>

#include <Wire.h>

#include "zip8ssd1306.h"

extern "C" void zip8Log(const char *text, size_t length) {
  Serial.write(text, length);
  Serial.write('\n');
}

bool ledOn = false;

unsigned char program[] = {
  0x69, 0x08, 0x6a, 0x0c, 0x8b, 0xd4, 0x4f, 0x01, 0x7a, 0x01, 0x8a, 0xc4,
  0x6e, 0x10, 0x8d, 0xe4, 0x4f, 0x01, 0x7c, 0x01, 0x6e, 0x20, 0x8e, 0xa2,
  0x3e, 0x00, 0x12, 0xa2, 0x6e, 0x0e, 0xee, 0x9e, 0x12, 0x26, 0x6d, 0x60,
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  0x42, 0x42, 0x42, 0x42, 0x42, 0x42, 0x42, 0x88, 0xe2, 0xa8, 0xaa
};
unsigned int program_len = 407;

#define OLED_DC     21
#define OLED_CS     6
#define OLED_RESET  20

Zip8SSD1306 display(SPI, OLED_DC, OLED_RESET, OLED_CS);

#define KEYBOARD_ADDRESS 0x48

uint8_t cpu[1395];

void panic(const char *why, int code) {
  Serial.print("failure: ");
  Serial.println(why);
  while (true) {
    digitalWrite(LED_BUILTIN, HIGH);
    delay(1000);
    digitalWrite(LED_BUILTIN, LOW);
    delay(1000);

    for (int i = 0; i < code; i++) {
      digitalWrite(LED_BUILTIN, HIGH);
      delay(250);
      digitalWrite(LED_BUILTIN, LOW);
      delay(250);
    }
    delay(750);
  }
}

// the setup function runs once when you press reset or power the board
void setup() {
  // initialize digital pin LED_BUILTIN as an output.
  pinMode(LED_BUILTIN, OUTPUT);
  Serial.begin(9600);
  Wire.begin();

  if (sizeof(cpu) != zip8CpuGetSize()) {
    panic("wrong cpu size", 5);
  }

  uint16_t err;
  if (zip8CpuInit(&err, cpu, program, program_len, 0, 0)) {
    Serial.println(zip8GetErrorName(err));
    panic("cpu init", 3);
  }

  if (!display.begin(SSD1306_SWITCHCAPVCC)) {
    panic("display alloc", 2);
  }
}

// the loop function runs over and over again forever
void loop() {
  unsigned long before = micros();

  digitalWrite(LED_BUILTIN, ledOn ? HIGH : LOW);
  ledOn = !ledOn;


  uint16_t err;
  for (int i = 0; i < 200; i++) {
    if (zip8CpuCycle(&err, cpu)) {
      Serial.println(zip8GetErrorName(err));
      panic("cpu cycle", 4);
    }
  }

  display.display(cpu);

  Wire.requestFrom(KEYBOARD_ADDRESS, 2);
  uint16_t keys = Wire.read();
  keys |= ((uint16_t)Wire.read()) << 8;
  zip8CpuSetKeys(cpu, keys);

  zip8CpuTimerTick(cpu);

  unsigned long after = micros();
  if ((after - before) < 16667) {
    delayMicroseconds(16667 - (after - before));
  }
  Serial.println(after - before);
}
